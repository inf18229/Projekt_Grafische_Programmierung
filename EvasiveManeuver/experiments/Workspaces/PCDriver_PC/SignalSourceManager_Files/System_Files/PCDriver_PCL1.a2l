ASAP2_VERSION 1 41
/begin PROJECT PCDriver_PC "Generated by ETAS from Project PCDriver_PC"
/begin HEADER "" VERSION "000" PROJECT_NO ASD /end HEADER
/begin MODULE PCDriver_PC "Generated by ETAS ASCET7 from Project: PCDriver_PC"
/begin IF_DATA E_TARGET
 /begin SOURCE "Task0" 3 /* period */ 10 QP_BLOB 1 /end SOURCE
 /begin TP_BLOB /* programm id */ 2818591350 /* target id */ 7 0 2 0 /end TP_BLOB
/end IF_DATA
/begin MOD_PAR "" VERSION "000" ADDR_EPK 0x0 EPK "" SUPPLIER "ETAS GmbH" CUSTOMER "xxx" CUSTOMER_NO "000" USER "xxx" PHONE_NO "000" ECU "PC" CPU_TYPE "PCx86" NO_OF_INTERFACES 1 /end MOD_PAR
/begin MOD_COMMON "Common definitions" BYTE_ORDER MSB_LAST ALIGNMENT_BYTE 1 ALIGNMENT_WORD 2 ALIGNMENT_LONG 4 ALIGNMENT_FLOAT32_IEEE 4 ALIGNMENT_FLOAT64_IEEE 8 /end MOD_COMMON
/begin MEASUREMENT myCar.myCar.myVehicle.MyTurn_instance.x "" FLOAT32_IEEE esdl_ident 1 100.0 -3.4028234663852886E+38 3.4028234663852886E+38 ECU_ADDRESS 0x0 /end MEASUREMENT
/begin MEASUREMENT myCar.myCar.myVehicle.MyTurn_instance.y "" FLOAT32_IEEE esdl_ident 1 100.0 -3.4028234663852886E+38 3.4028234663852886E+38 ECU_ADDRESS 0x0 /end MEASUREMENT
/begin MEASUREMENT myCar.myCar.myVehicle.MyTurn_instance.bearing "" FLOAT32_IEEE esdl_ident 1 100.0 -3.4028234663852886E+38 3.4028234663852886E+38 ECU_ADDRESS 0x0 /end MEASUREMENT
/begin CHARACTERISTIC myCar.myCar.myVehicle.MyTurn_instance.D "" VALUE 0x0 STANDARD_VALUE_R32 0.0 esdl_ident -3.4028234663852886E+38 3.4028234663852886E+38 /end CHARACTERISTIC
/begin MEASUREMENT myCar.myCar.myVehicle.MyTurn_instance.dpi "" FLOAT32_IEEE esdl_ident 1 100.0 -3.4028234663852886E+38 3.4028234663852886E+38 ECU_ADDRESS 0x0 /end MEASUREMENT
/begin MEASUREMENT myCar.myCar.myVehicle.MyTurn_instance.pi "" FLOAT32_IEEE esdl_ident 1 100.0 -3.4028234663852886E+38 3.4028234663852886E+38 ECU_ADDRESS 0x0 /end MEASUREMENT
/begin CHARACTERISTIC myCar.myCar.myVehicle.BrakeMomentum "" CURVE 0x0 STANDARD_CURVE_R32R32 0.0 esdl_ident -3.4028234663852886E+38 3.4028234663852886E+38
 /begin AXIS_DESCR STD_AXIS NO_INPUT_QUANTITY esdl_ident 6 -3.4028234663852886E+38 3.4028234663852886E+38 /end AXIS_DESCR
/end CHARACTERISTIC
/begin CHARACTERISTIC myCar.myCar.myVehicle.EngineMomentum "" MAP 0x0 STANDARD_MAP_R32R32R32 0.0 esdl_ident -3.4028234663852886E+38 3.4028234663852886E+38
 /begin AXIS_DESCR STD_AXIS NO_INPUT_QUANTITY esdl_ident 6 -3.4028234663852886E+38 3.4028234663852886E+38 /end AXIS_DESCR
 /begin AXIS_DESCR STD_AXIS myCar.myDrive_3.v esdl_ident 6 -3.4028234663852886E+38 3.4028234663852886E+38 /end AXIS_DESCR
/end CHARACTERISTIC
/begin CHARACTERISTIC myCar.myCar.myVehicle.AirFriction "" CURVE 0x0 STANDARD_CURVE_R32R32 0.0 esdl_ident -3.4028234663852886E+38 3.4028234663852886E+38
 /begin AXIS_DESCR STD_AXIS myCar.myDrive_3.v esdl_ident 6 -3.4028234663852886E+38 3.4028234663852886E+38 /end AXIS_DESCR
/end CHARACTERISTIC
/begin MEASUREMENT myCar.myCar.myVehicle.h "" FLOAT32_IEEE esdl_ident 1 100.0 -3.4028234663852886E+38 3.4028234663852886E+38 ECU_ADDRESS 0x0 /end MEASUREMENT
/begin MEASUREMENT myCar.myCar.myVehicle.dh "" FLOAT32_IEEE esdl_ident 1 100.0 -3.4028234663852886E+38 3.4028234663852886E+38 ECU_ADDRESS 0x0 /end MEASUREMENT
/begin MEASUREMENT myCar.myCar.myVehicle.ds "" FLOAT32_IEEE esdl_ident 1 100.0 -3.4028234663852886E+38 3.4028234663852886E+38 ECU_ADDRESS 0x0 /end MEASUREMENT
/begin MEASUREMENT myCar.myCar.myVehicle.momentum "" FLOAT32_IEEE esdl_ident 1 100.0 -3.4028234663852886E+38 3.4028234663852886E+38 ECU_ADDRESS 0x0 /end MEASUREMENT
/begin MEASUREMENT myCar.myCar.myVehicle.dist "" FLOAT32_IEEE esdl_ident 1 100.0 -3.4028234663852886E+38 3.4028234663852886E+38 ECU_ADDRESS 0x0 /end MEASUREMENT
/begin MEASUREMENT myCar.myCar.myVehicle.v "" UWORD esdl_f0_01_kmh 1 100.0 0.0 200.0 ECU_ADDRESS 0x0 /end MEASUREMENT
/begin MEASUREMENT myCar.myCar.myVehicle.x "" FLOAT32_IEEE esdl_ident 1 100.0 -3.4028234663852886E+38 3.4028234663852886E+38 ECU_ADDRESS 0x0 /end MEASUREMENT
/begin MEASUREMENT myCar.myCar.myVehicle.y "" FLOAT32_IEEE esdl_ident 1 100.0 -3.4028234663852886E+38 3.4028234663852886E+38 ECU_ADDRESS 0x0 /end MEASUREMENT
/begin MEASUREMENT myCar.myCar.myVehicle.bearing "" FLOAT32_IEEE esdl_ident 1 100.0 -3.4028234663852886E+38 3.4028234663852886E+38 ECU_ADDRESS 0x0 /end MEASUREMENT
/begin MEASUREMENT myCar.myCar.time "" FLOAT32_IEEE esdl_ident 1 100.0 -3.4028234663852886E+38 3.4028234663852886E+38 ECU_ADDRESS 0x0 /end MEASUREMENT
/begin CHARACTERISTIC myCar.myCar.g "" VALUE 0x0 STANDARD_VALUE_R32 0.0 esdl_ident -3.4028234663852886E+38 3.4028234663852886E+38 /end CHARACTERISTIC
/begin CHARACTERISTIC myCar.myCar.Landscape "" CURVE 0x0 STANDARD_CURVE_R32R32 0.0 esdl_ident -3.4028234663852886E+38 3.4028234663852886E+38
 /begin AXIS_DESCR STD_AXIS NO_INPUT_QUANTITY esdl_ident 128 -3.4028234663852886E+38 3.4028234663852886E+38 /end AXIS_DESCR
/end CHARACTERISTIC
/begin CHARACTERISTIC myCar.myCar.TrackSize "" VALUE 0x0 STANDARD_VALUE_R32 0.0 esdl_ident -3.4028234663852886E+38 3.4028234663852886E+38 /end CHARACTERISTIC
/begin MEASUREMENT resources.CarMessages.v "" UWORD esdl_f0_01_kmh_km2fh 1 100.0 0.0 200.0 ECU_ADDRESS 0x0 /end MEASUREMENT
/begin MEASUREMENT resources.CarMessages.power "" FLOAT32_IEEE esdl_ident 1 100.0 -3.4028234663852886E+38 3.4028234663852886E+38 ECU_ADDRESS 0x0 /end MEASUREMENT
/begin MEASUREMENT resources.CarMessages.brake "" FLOAT32_IEEE esdl_ident 1 100.0 -3.4028234663852886E+38 3.4028234663852886E+38 ECU_ADDRESS 0x0 /end MEASUREMENT
/begin MEASUREMENT resources.CarMessages.steering "" FLOAT32_IEEE esdl_ident_rad 1 100.0 -3.4028234663852886E+38 3.4028234663852886E+38 ECU_ADDRESS 0x0 /end MEASUREMENT
/begin MEASUREMENT resources.CarMessages.bearing "" FLOAT32_IEEE esdl_ident_b0 1 100.0 -3.4028234663852886E+38 3.4028234663852886E+38 ECU_ADDRESS 0x0 /end MEASUREMENT
/begin MEASUREMENT resources.CarMessages.x "" FLOAT32_IEEE esdl_ident_m 1 100.0 -3.4028234663852886E+38 3.4028234663852886E+38 ECU_ADDRESS 0x0 /end MEASUREMENT
/begin MEASUREMENT resources.CarMessages.y "" FLOAT32_IEEE esdl_ident_m 1 100.0 -3.4028234663852886E+38 3.4028234663852886E+38 ECU_ADDRESS 0x0 /end MEASUREMENT
/begin MEASUREMENT resources.CarMessages.SM_left_active "" UBYTE esdl_ident 1 100.0 0 1 ECU_ADDRESS 0x0 BIT_MASK 0x1 /end MEASUREMENT
/begin MEASUREMENT resources.CarMessages.SM_right_active "" UBYTE esdl_ident 1 100.0 0 1 ECU_ADDRESS 0x0 BIT_MASK 0x1 /end MEASUREMENT
/begin MEASUREMENT myCar.Driver.Obstacles_instance.min_dist_to_obst "" FLOAT32_IEEE esdl_ident 1 100.0 -3.4028234663852886E+38 3.4028234663852886E+38 ECU_ADDRESS 0x0 /end MEASUREMENT
/begin CHARACTERISTIC myCar.Driver.Driver_Tempo_instance.power "" VALUE 0x0 STANDARD_VALUE_R32 0.0 esdl_ident -3.4028234663852886E+38 3.4028234663852886E+38 /end CHARACTERISTIC
/begin MEASUREMENT myCar.Driver.Driver_Tempo_instance.power_out "" FLOAT32_IEEE esdl_ident 1 100.0 -3.4028234663852886E+38 3.4028234663852886E+38 ECU_ADDRESS 0x0 /end MEASUREMENT
/begin MEASUREMENT myCar.Driver.Driver_Tempo_instance.brake_out "" FLOAT32_IEEE esdl_ident 1 100.0 -3.4028234663852886E+38 3.4028234663852886E+38 ECU_ADDRESS 0x0 /end MEASUREMENT
/begin CHARACTERISTIC myCar.Driver.v_target "" VALUE 0x0 STANDARD_VALUE_U16 0.0 esdl_f0_01_kmh 0.0 200.0 /end CHARACTERISTIC
/begin MEASUREMENT myCar.Driver.distance_next_Obstacle "" FLOAT32_IEEE esdl_ident 1 100.0 -3.4028234663852886E+38 3.4028234663852886E+38 ECU_ADDRESS 0x0 /end MEASUREMENT
/begin MEASUREMENT myCar.Driver.min_dist_to_obstacle "" FLOAT32_IEEE esdl_ident 1 100.0 -3.4028234663852886E+38 3.4028234663852886E+38 ECU_ADDRESS 0x0 /end MEASUREMENT
/begin CHARACTERISTIC myCar.Driver.Lane_Change_right "" VALUE 0x0 STANDARD_VALUE_U8 0.0 esdl_ident 0 1 BIT_MASK 0x1 /end CHARACTERISTIC
/begin CHARACTERISTIC myCar.Driver.Lane_Change_left "" VALUE 0x0 STANDARD_VALUE_U8 0.0 esdl_ident 0 1 BIT_MASK 0x1 /end CHARACTERISTIC
/begin MEASUREMENT myCar.Driver.real_distance_to_next_obst "" FLOAT32_IEEE esdl_ident 1 100.0 -3.4028234663852886E+38 3.4028234663852886E+38 ECU_ADDRESS 0x0 /end MEASUREMENT
/begin CHARACTERISTIC myCar.Driver.manual_lane_changing "" VALUE 0x0 STANDARD_VALUE_U8 0.0 esdl_ident 0 1 BIT_MASK 0x1 /end CHARACTERISTIC
/begin MEASUREMENT resources.DriverMessages.power "" FLOAT32_IEEE esdl_ident 1 100.0 -3.4028234663852886E+38 3.4028234663852886E+38 ECU_ADDRESS 0x0 /end MEASUREMENT
/begin MEASUREMENT resources.DriverMessages.brake "" FLOAT32_IEEE esdl_ident 1 100.0 -3.4028234663852886E+38 3.4028234663852886E+38 ECU_ADDRESS 0x0 /end MEASUREMENT
/begin MEASUREMENT resources.DriverMessages.on "" UBYTE esdl_ident 1 100.0 0 1 ECU_ADDRESS 0x0 BIT_MASK 0x1 /end MEASUREMENT
/begin MEASUREMENT resources.DriverMessages.deviation "" FLOAT32_IEEE esdl_ident 1 100.0 -3.4028234663852886E+38 3.4028234663852886E+38 ECU_ADDRESS 0x0 /end MEASUREMENT
/begin MEASUREMENT resources.DriverMessages.emergency "" UBYTE esdl_ident 1 100.0 0 1 ECU_ADDRESS 0x0 BIT_MASK 0x1 /end MEASUREMENT
/begin MEASUREMENT resources.DriverMessages.v_target "" UWORD esdl_f0_01_kmh 1 100.0 0.0 200.0 ECU_ADDRESS 0x0 /end MEASUREMENT
/begin MEASUREMENT resources.DriverMessages.laneChange_right "" UBYTE esdl_ident 1 100.0 0 1 ECU_ADDRESS 0x0 BIT_MASK 0x1 /end MEASUREMENT
/begin MEASUREMENT resources.DriverMessages.automatic_laneChange_right "" UBYTE esdl_ident 1 100.0 0 1 ECU_ADDRESS 0x0 BIT_MASK 0x1 /end MEASUREMENT
/begin MEASUREMENT resources.DriverMessages.laneChange_left "" UBYTE esdl_ident 1 100.0 0 1 ECU_ADDRESS 0x0 BIT_MASK 0x1 /end MEASUREMENT
/begin MEASUREMENT resources.DriverMessages.automatic_laneChange_left "" UBYTE esdl_ident 1 100.0 0 1 ECU_ADDRESS 0x0 BIT_MASK 0x1 /end MEASUREMENT
/begin MEASUREMENT resources.DriverMessages.real_distance_to_next_obst "" FLOAT32_IEEE esdl_ident 1 100.0 -3.4028234663852886E+38 3.4028234663852886E+38 ECU_ADDRESS 0x0 /end MEASUREMENT
/begin MEASUREMENT myCar.EvasiveManeuver.SM_laneChange_left_instance.obj_links.steering "" FLOAT32_IEEE esdl_ident 1 100.0 -3.4028234663852886E+38 3.4028234663852886E+38 ECU_ADDRESS 0x0 /end MEASUREMENT
/begin MEASUREMENT myCar.EvasiveManeuver.SM_laneChange_left_instance.obj_rechts.steering "" FLOAT32_IEEE esdl_ident 1 100.0 -3.4028234663852886E+38 3.4028234663852886E+38 ECU_ADDRESS 0x0 /end MEASUREMENT
/begin MEASUREMENT myCar.EvasiveManeuver.SM_laneChange_left_instance.sm "" UBYTE esdl_myCar_SM_ausweichenStatemachineStates 1 100.0 0 5 ECU_ADDRESS 0x0 /end MEASUREMENT
/begin MEASUREMENT myCar.EvasiveManeuver.SM_laneChange_left_instance.emergency_msg "" UBYTE esdl_ident 1 100.0 0 1 ECU_ADDRESS 0x0 BIT_MASK 0x1 /end MEASUREMENT
/begin MEASUREMENT myCar.EvasiveManeuver.SM_laneChange_left_instance.count "" FLOAT32_IEEE esdl_ident 1 100.0 -3.4028234663852886E+38 3.4028234663852886E+38 ECU_ADDRESS 0x0 /end MEASUREMENT
/begin MEASUREMENT myCar.EvasiveManeuver.SM_laneChange_left_instance.steering_out "" FLOAT32_IEEE esdl_ident 1 100.0 -3.4028234663852886E+38 3.4028234663852886E+38 ECU_ADDRESS 0x0 /end MEASUREMENT
/begin MEASUREMENT myCar.EvasiveManeuver.SM_laneChange_left_instance.max_count "" FLOAT32_IEEE esdl_ident 1 100.0 -3.4028234663852886E+38 3.4028234663852886E+38 ECU_ADDRESS 0x0 /end MEASUREMENT
/begin MEASUREMENT myCar.EvasiveManeuver.SM_laneChange_left_instance.active "" UBYTE esdl_ident 1 100.0 0 1 ECU_ADDRESS 0x0 BIT_MASK 0x1 /end MEASUREMENT
/begin MEASUREMENT myCar.EvasiveManeuver.SM_laneChange_right_instance.obj_links.steering "" FLOAT32_IEEE esdl_ident 1 100.0 -3.4028234663852886E+38 3.4028234663852886E+38 ECU_ADDRESS 0x0 /end MEASUREMENT
/begin MEASUREMENT myCar.EvasiveManeuver.SM_laneChange_right_instance.obj_rechts.steering "" FLOAT32_IEEE esdl_ident 1 100.0 -3.4028234663852886E+38 3.4028234663852886E+38 ECU_ADDRESS 0x0 /end MEASUREMENT
/begin MEASUREMENT myCar.EvasiveManeuver.SM_laneChange_right_instance.sm "" UBYTE esdl_myCar_SM_laneChange_rightStatemachineStates 1 100.0 0 5 ECU_ADDRESS 0x0 /end MEASUREMENT
/begin MEASUREMENT myCar.EvasiveManeuver.SM_laneChange_right_instance.emergency_msg "" UBYTE esdl_ident 1 100.0 0 1 ECU_ADDRESS 0x0 BIT_MASK 0x1 /end MEASUREMENT
/begin MEASUREMENT myCar.EvasiveManeuver.SM_laneChange_right_instance.count "" FLOAT32_IEEE esdl_ident 1 100.0 -3.4028234663852886E+38 3.4028234663852886E+38 ECU_ADDRESS 0x0 /end MEASUREMENT
/begin MEASUREMENT myCar.EvasiveManeuver.SM_laneChange_right_instance.steering_out "" FLOAT32_IEEE esdl_ident 1 100.0 -3.4028234663852886E+38 3.4028234663852886E+38 ECU_ADDRESS 0x0 /end MEASUREMENT
/begin MEASUREMENT myCar.EvasiveManeuver.SM_laneChange_right_instance.max_count "" FLOAT32_IEEE esdl_ident 1 100.0 -3.4028234663852886E+38 3.4028234663852886E+38 ECU_ADDRESS 0x0 /end MEASUREMENT
/begin MEASUREMENT myCar.EvasiveManeuver.SM_laneChange_right_instance.active "" UBYTE esdl_ident 1 100.0 0 1 ECU_ADDRESS 0x0 BIT_MASK 0x1 /end MEASUREMENT
/begin MEASUREMENT myCar.EvasiveManeuver.Pre_Condition_Maneuver_instance.EdgeFalling_instance.buffer "" UBYTE esdl_ident 1 100.0 0 1 ECU_ADDRESS 0x0 BIT_MASK 0x1 /end MEASUREMENT
/begin MEASUREMENT myCar.EvasiveManeuver.Pre_Condition_Maneuver_instance.EdgeFalling_instance.oldSignal "" UBYTE esdl_ident 1 100.0 0 1 ECU_ADDRESS 0x0 BIT_MASK 0x1 /end MEASUREMENT
/begin MEASUREMENT myCar.EvasiveManeuver.Pre_Condition_Maneuver_instance.EdgeRising_instance.buffer "" UBYTE esdl_ident 1 100.0 0 1 ECU_ADDRESS 0x0 BIT_MASK 0x1 /end MEASUREMENT
/begin MEASUREMENT myCar.EvasiveManeuver.Pre_Condition_Maneuver_instance.EdgeRising_instance.oldSignal "" UBYTE esdl_ident 1 100.0 0 1 ECU_ADDRESS 0x0 BIT_MASK 0x1 /end MEASUREMENT
/begin MEASUREMENT myCar.EvasiveManeuver.Pre_Condition_Maneuver_instance.max_count_out "" FLOAT32_IEEE esdl_ident 1 100.0 -3.4028234663852886E+38 3.4028234663852886E+38 ECU_ADDRESS 0x0 /end MEASUREMENT
/begin MEASUREMENT myCar.EvasiveManeuver.Pre_Condition_Maneuver_instance.SM_left_Change_out "" UBYTE esdl_ident 1 100.0 0 1 ECU_ADDRESS 0x0 BIT_MASK 0x1 /end MEASUREMENT
/begin MEASUREMENT myCar.EvasiveManeuver.Pre_Condition_Maneuver_instance.SM_right_Change_out "" UBYTE esdl_ident 1 100.0 0 1 ECU_ADDRESS 0x0 BIT_MASK 0x1 /end MEASUREMENT
/begin MEASUREMENT myCar.systemTest.systemTest_sucess "" UBYTE esdl_ident 1 100.0 0 1 ECU_ADDRESS 0x0 BIT_MASK 0x1 /end MEASUREMENT
/begin COMPU_METHOD esdl_f0_01_kmh "" RAT_FUNC "%12.4" "" COEFFS 0 100 0 0 0 1 /end COMPU_METHOD
/begin COMPU_METHOD esdl_f0_01_kmh_km2fh "" RAT_FUNC "%12.4" "km/h" COEFFS 0 100 0 0 0 1 /end COMPU_METHOD
/begin COMPU_METHOD esdl_ident "" RAT_FUNC "%12.4" "" COEFFS 0 1 0 0 0 1 /end COMPU_METHOD
/begin COMPU_METHOD esdl_ident_b0 "" RAT_FUNC "%12.4" "°" COEFFS 0 1 0 0 0 1 /end COMPU_METHOD
/begin COMPU_METHOD esdl_ident_m "" RAT_FUNC "%12.4" "m" COEFFS 0 1 0 0 0 1 /end COMPU_METHOD
/begin COMPU_METHOD esdl_ident_rad "" RAT_FUNC "%12.4" "rad" COEFFS 0 1 0 0 0 1 /end COMPU_METHOD
/begin COMPU_METHOD esdl_myCar_SM_ausweichenStatemachineStates "" TAB_VERB "%12.4" "" /* compu_tab_ref */ COMPU_TAB_REF esdl_myCar_SM_ausweichenStatemachineStates_vtab /end COMPU_METHOD
/begin COMPU_VTAB esdl_myCar_SM_ausweichenStatemachineStates_vtab "" TAB_VERB /* number value pairs */ 6 0 "idle" 4 "turn_left" 3 "straighten_right" 5 "turn_right" 2 "straighten_left" 1 "Done" /* default value */ DEFAULT_VALUE "Error" /end COMPU_VTAB
/begin COMPU_METHOD esdl_myCar_SM_laneChange_rightStatemachineStates "" TAB_VERB "%12.4" "" /* compu_tab_ref */ COMPU_TAB_REF esdl_myCar_SM_laneChange_rightStatemachineStates_vtab /end COMPU_METHOD
/begin COMPU_VTAB esdl_myCar_SM_laneChange_rightStatemachineStates_vtab "" TAB_VERB /* number value pairs */ 6 0 "idle" 4 "turn_left" 3 "straighten_right" 5 "turn_right" 2 "straighten_left" 1 "Done" /* default value */ DEFAULT_VALUE "Error" /end COMPU_VTAB
/begin FUNCTION myCar.TimeBase "" /end FUNCTION
/begin FUNCTION myCar.myCar "" /begin DEF_CHARACTERISTIC myCar.myCar.g myCar.myCar.Landscape myCar.myCar.TrackSize /end DEF_CHARACTERISTIC
 /begin IN_MEASUREMENT resources.CarMessages.brake resources.CarMessages.power resources.CarMessages.steering /end IN_MEASUREMENT
 /begin OUT_MEASUREMENT resources.CarMessages.bearing resources.CarMessages.v resources.CarMessages.x resources.CarMessages.y /end OUT_MEASUREMENT
 /begin LOC_MEASUREMENT myCar.myCar.time /end LOC_MEASUREMENT
 /begin SUB_FUNCTION myCar.myCar.myVehicle /end SUB_FUNCTION
/end FUNCTION
/begin FUNCTION myCar.myCar.myVehicle ""
 /begin DEF_CHARACTERISTIC myCar.myCar.myVehicle.BrakeMomentum myCar.myCar.myVehicle.EngineMomentum myCar.myCar.myVehicle.AirFriction /end DEF_CHARACTERISTIC
 /begin LOC_MEASUREMENT myCar.myCar.myVehicle.bearing myCar.myCar.myVehicle.dh myCar.myCar.myVehicle.dist myCar.myCar.myVehicle.ds myCar.myCar.myVehicle.h myCar.myCar.myVehicle.momentum myCar.myCar.myVehicle.v myCar.myCar.myVehicle.x myCar.myCar.myVehicle.y /end LOC_MEASUREMENT
 /begin SUB_FUNCTION myCar.myCar.myVehicle.MyTurn_instance /end SUB_FUNCTION
/end FUNCTION
/begin FUNCTION myCar.myCar.myVehicle.MyTurn_instance "" /begin DEF_CHARACTERISTIC myCar.myCar.myVehicle.MyTurn_instance.D /end DEF_CHARACTERISTIC
 /begin LOC_MEASUREMENT myCar.myCar.myVehicle.MyTurn_instance.bearing myCar.myCar.myVehicle.MyTurn_instance.dpi myCar.myCar.myVehicle.MyTurn_instance.pi myCar.myCar.myVehicle.MyTurn_instance.x myCar.myCar.myVehicle.MyTurn_instance.y /end LOC_MEASUREMENT
 /begin SUB_FUNCTION myCar.myCar.myVehicle.MyTurn_instance.Lib /end SUB_FUNCTION
/end FUNCTION
/begin FUNCTION myCar.myCar.myVehicle.MyTurn_instance.Lib "MathLib is a C code class that returns the results of numerous mathematical functions." /end FUNCTION
/begin FUNCTION myCar.Driver ""
 /begin DEF_CHARACTERISTIC myCar.Driver.v_target myCar.Driver.Lane_Change_right myCar.Driver.Lane_Change_left myCar.Driver.manual_lane_changing /end DEF_CHARACTERISTIC
 /begin IN_MEASUREMENT resources.CarMessages.v resources.CarMessages.x resources.CarMessages.y resources.DriverMessages.automatic_laneChange_left resources.DriverMessages.automatic_laneChange_right /end IN_MEASUREMENT
 /begin OUT_MEASUREMENT resources.CarMessages.brake resources.CarMessages.power resources.DriverMessages.emergency resources.DriverMessages.laneChange_left resources.DriverMessages.laneChange_right resources.DriverMessages.v_target /end OUT_MEASUREMENT
 /begin LOC_MEASUREMENT myCar.Driver.distance_next_Obstacle myCar.Driver.min_dist_to_obstacle myCar.Driver.real_distance_to_next_obst /end LOC_MEASUREMENT
 /begin SUB_FUNCTION myCar.Driver.Driver_Tempo_instance myCar.Driver.Obstacles_instance myCar.Driver.calcDistance_instance /end SUB_FUNCTION
/end FUNCTION
/begin FUNCTION myCar.Driver.Obstacles_instance "" /begin LOC_MEASUREMENT myCar.Driver.Obstacles_instance.min_dist_to_obst /end LOC_MEASUREMENT /end FUNCTION
/begin FUNCTION myCar.Driver.Driver_Tempo_instance "" /begin DEF_CHARACTERISTIC myCar.Driver.Driver_Tempo_instance.power /end DEF_CHARACTERISTIC
 /begin LOC_MEASUREMENT myCar.Driver.Driver_Tempo_instance.brake_out myCar.Driver.Driver_Tempo_instance.power_out /end LOC_MEASUREMENT
/end FUNCTION
/begin FUNCTION myCar.Driver.calcDistance_instance "" /begin SUB_FUNCTION myCar.Driver.calcDistance_instance.MathLib_instance /end SUB_FUNCTION /end FUNCTION
/begin FUNCTION myCar.Driver.calcDistance_instance.MathLib_instance "MathLib is a C code class that returns the results of numerous mathematical functions." /end FUNCTION
/begin FUNCTION myCar.EvasiveManeuver ""
 /begin IN_MEASUREMENT resources.DriverMessages.emergency resources.DriverMessages.laneChange_left resources.DriverMessages.laneChange_right resources.DriverMessages.v_target /end IN_MEASUREMENT
 /begin OUT_MEASUREMENT resources.CarMessages.SM_left_active resources.CarMessages.SM_right_active resources.CarMessages.steering /end OUT_MEASUREMENT
 /begin SUB_FUNCTION myCar.EvasiveManeuver.Pre_Condition_Maneuver_instance myCar.EvasiveManeuver.SM_laneChange_left_instance myCar.EvasiveManeuver.SM_laneChange_right_instance /end SUB_FUNCTION
/end FUNCTION
/begin FUNCTION myCar.EvasiveManeuver.SM_laneChange_left_instance ""
 /begin LOC_MEASUREMENT myCar.EvasiveManeuver.SM_laneChange_left_instance.active myCar.EvasiveManeuver.SM_laneChange_left_instance.count myCar.EvasiveManeuver.SM_laneChange_left_instance.emergency_msg myCar.EvasiveManeuver.SM_laneChange_left_instance.max_count myCar.EvasiveManeuver.SM_laneChange_left_instance.sm myCar.EvasiveManeuver.SM_laneChange_left_instance.steering_out /end LOC_MEASUREMENT
 /begin SUB_FUNCTION myCar.EvasiveManeuver.SM_laneChange_left_instance.obj_links myCar.EvasiveManeuver.SM_laneChange_left_instance.obj_rechts /end SUB_FUNCTION
/end FUNCTION
/begin FUNCTION myCar.EvasiveManeuver.SM_laneChange_left_instance.obj_links ""
 /begin LOC_MEASUREMENT myCar.EvasiveManeuver.SM_laneChange_left_instance.obj_links.steering /end LOC_MEASUREMENT
/end FUNCTION
/begin FUNCTION myCar.EvasiveManeuver.SM_laneChange_left_instance.obj_rechts ""
 /begin LOC_MEASUREMENT myCar.EvasiveManeuver.SM_laneChange_left_instance.obj_rechts.steering /end LOC_MEASUREMENT
/end FUNCTION
/begin FUNCTION myCar.EvasiveManeuver.SM_laneChange_right_instance ""
 /begin LOC_MEASUREMENT myCar.EvasiveManeuver.SM_laneChange_right_instance.active myCar.EvasiveManeuver.SM_laneChange_right_instance.count myCar.EvasiveManeuver.SM_laneChange_right_instance.emergency_msg myCar.EvasiveManeuver.SM_laneChange_right_instance.max_count myCar.EvasiveManeuver.SM_laneChange_right_instance.sm myCar.EvasiveManeuver.SM_laneChange_right_instance.steering_out /end LOC_MEASUREMENT
 /begin SUB_FUNCTION myCar.EvasiveManeuver.SM_laneChange_right_instance.obj_links myCar.EvasiveManeuver.SM_laneChange_right_instance.obj_rechts /end SUB_FUNCTION
/end FUNCTION
/begin FUNCTION myCar.EvasiveManeuver.SM_laneChange_right_instance.obj_links ""
 /begin LOC_MEASUREMENT myCar.EvasiveManeuver.SM_laneChange_right_instance.obj_links.steering /end LOC_MEASUREMENT
/end FUNCTION
/begin FUNCTION myCar.EvasiveManeuver.SM_laneChange_right_instance.obj_rechts ""
 /begin LOC_MEASUREMENT myCar.EvasiveManeuver.SM_laneChange_right_instance.obj_rechts.steering /end LOC_MEASUREMENT
/end FUNCTION
/begin FUNCTION myCar.EvasiveManeuver.Pre_Condition_Maneuver_instance ""
 /begin LOC_MEASUREMENT myCar.EvasiveManeuver.Pre_Condition_Maneuver_instance.SM_left_Change_out myCar.EvasiveManeuver.Pre_Condition_Maneuver_instance.SM_right_Change_out myCar.EvasiveManeuver.Pre_Condition_Maneuver_instance.max_count_out /end LOC_MEASUREMENT
 /begin SUB_FUNCTION myCar.EvasiveManeuver.Pre_Condition_Maneuver_instance.EdgeFalling_instance myCar.EvasiveManeuver.Pre_Condition_Maneuver_instance.EdgeRising_instance /end SUB_FUNCTION
/end FUNCTION
/begin FUNCTION myCar.EvasiveManeuver.Pre_Condition_Maneuver_instance.EdgeFalling_instance "EdgeFalling detects a falling edge of the logical input signal."
 /begin LOC_MEASUREMENT myCar.EvasiveManeuver.Pre_Condition_Maneuver_instance.EdgeFalling_instance.buffer myCar.EvasiveManeuver.Pre_Condition_Maneuver_instance.EdgeFalling_instance.oldSignal /end LOC_MEASUREMENT
/end FUNCTION
/begin FUNCTION myCar.EvasiveManeuver.Pre_Condition_Maneuver_instance.EdgeRising_instance "EdgeRising detects a rising edge of the logical input signal."
 /begin LOC_MEASUREMENT myCar.EvasiveManeuver.Pre_Condition_Maneuver_instance.EdgeRising_instance.buffer myCar.EvasiveManeuver.Pre_Condition_Maneuver_instance.EdgeRising_instance.oldSignal /end LOC_MEASUREMENT
/end FUNCTION
/begin FUNCTION myCar.systemTest ""
 /begin IN_MEASUREMENT resources.CarMessages.SM_left_active resources.CarMessages.SM_right_active resources.CarMessages.x resources.CarMessages.y resources.DriverMessages.real_distance_to_next_obst /end IN_MEASUREMENT
 /begin OUT_MEASUREMENT resources.DriverMessages.automatic_laneChange_left resources.DriverMessages.automatic_laneChange_right /end OUT_MEASUREMENT
 /begin LOC_MEASUREMENT myCar.systemTest.systemTest_sucess /end LOC_MEASUREMENT
/end FUNCTION
/begin FUNCTION coverageLib.CoverageInstrumentation "" /end FUNCTION
/begin RECORD_LAYOUT STANDARD_CURVE_R32R32 /* axis size */ NO_AXIS_PTS_X 1 UWORD /* axis */ AXIS_PTS_X 2 FLOAT32_IEEE INDEX_INCR DIRECT FNC_VALUES 3 FLOAT32_IEEE COLUMN_DIR DIRECT /end RECORD_LAYOUT
/begin RECORD_LAYOUT STANDARD_MAP_R32R32R32 /* x axis size */ NO_AXIS_PTS_X 1 UWORD /* y axis size */ NO_AXIS_PTS_Y 2 UWORD /* x axis */ AXIS_PTS_X 3 FLOAT32_IEEE INDEX_INCR DIRECT /* y axis */ AXIS_PTS_Y 4 FLOAT32_IEEE INDEX_INCR DIRECT FNC_VALUES 5 FLOAT32_IEEE COLUMN_DIR DIRECT /end RECORD_LAYOUT
/begin RECORD_LAYOUT STANDARD_VALUE_R32 FNC_VALUES 1 FLOAT32_IEEE COLUMN_DIR DIRECT /end RECORD_LAYOUT
/begin RECORD_LAYOUT STANDARD_VALUE_U16 FNC_VALUES 1 UWORD COLUMN_DIR DIRECT /end RECORD_LAYOUT
/begin RECORD_LAYOUT STANDARD_VALUE_U8 FNC_VALUES 1 UBYTE COLUMN_DIR DIRECT /end RECORD_LAYOUT
/begin GROUP coverageLib.CoverageInstrumentation "" ROOT /end GROUP
/begin GROUP myCar.Driver "" ROOT
 /begin REF_CHARACTERISTIC myCar.Driver.v_target myCar.Driver.Lane_Change_right myCar.Driver.Lane_Change_left myCar.Driver.manual_lane_changing /end REF_CHARACTERISTIC
 /begin REF_MEASUREMENT myCar.Driver.distance_next_Obstacle myCar.Driver.min_dist_to_obstacle myCar.Driver.real_distance_to_next_obst /end REF_MEASUREMENT
 /begin SUB_GROUP myCar.Driver.Driver_Tempo_instance myCar.Driver.Obstacles_instance myCar.Driver.calcDistance_instance /end SUB_GROUP
/end GROUP
/begin GROUP myCar.Driver.Driver_Tempo_instance "" /begin REF_CHARACTERISTIC myCar.Driver.Driver_Tempo_instance.power /end REF_CHARACTERISTIC
 /begin REF_MEASUREMENT myCar.Driver.Driver_Tempo_instance.brake_out myCar.Driver.Driver_Tempo_instance.power_out /end REF_MEASUREMENT
/end GROUP
/begin GROUP myCar.Driver.Obstacles_instance "" /begin REF_MEASUREMENT myCar.Driver.Obstacles_instance.min_dist_to_obst /end REF_MEASUREMENT /end GROUP
/begin GROUP myCar.Driver.calcDistance_instance "" /begin SUB_GROUP myCar.Driver.calcDistance_instance.MathLib_instance /end SUB_GROUP /end GROUP
/begin GROUP myCar.Driver.calcDistance_instance.MathLib_instance "MathLib is a C code class that returns the results of numerous mathematical functions." /end GROUP
/begin GROUP myCar.EvasiveManeuver "" ROOT
 /begin SUB_GROUP myCar.EvasiveManeuver.Pre_Condition_Maneuver_instance myCar.EvasiveManeuver.SM_laneChange_left_instance myCar.EvasiveManeuver.SM_laneChange_right_instance /end SUB_GROUP
/end GROUP
/begin GROUP myCar.EvasiveManeuver.Pre_Condition_Maneuver_instance ""
 /begin REF_MEASUREMENT myCar.EvasiveManeuver.Pre_Condition_Maneuver_instance.SM_left_Change_out myCar.EvasiveManeuver.Pre_Condition_Maneuver_instance.SM_right_Change_out myCar.EvasiveManeuver.Pre_Condition_Maneuver_instance.max_count_out /end REF_MEASUREMENT
 /begin SUB_GROUP myCar.EvasiveManeuver.Pre_Condition_Maneuver_instance.EdgeFalling_instance myCar.EvasiveManeuver.Pre_Condition_Maneuver_instance.EdgeRising_instance /end SUB_GROUP
/end GROUP
/begin GROUP myCar.EvasiveManeuver.Pre_Condition_Maneuver_instance.EdgeFalling_instance "EdgeFalling detects a falling edge of the logical input signal."
 /begin REF_MEASUREMENT myCar.EvasiveManeuver.Pre_Condition_Maneuver_instance.EdgeFalling_instance.buffer myCar.EvasiveManeuver.Pre_Condition_Maneuver_instance.EdgeFalling_instance.oldSignal /end REF_MEASUREMENT
/end GROUP
/begin GROUP myCar.EvasiveManeuver.Pre_Condition_Maneuver_instance.EdgeRising_instance "EdgeRising detects a rising edge of the logical input signal."
 /begin REF_MEASUREMENT myCar.EvasiveManeuver.Pre_Condition_Maneuver_instance.EdgeRising_instance.buffer myCar.EvasiveManeuver.Pre_Condition_Maneuver_instance.EdgeRising_instance.oldSignal /end REF_MEASUREMENT
/end GROUP
/begin GROUP myCar.EvasiveManeuver.SM_laneChange_left_instance ""
 /begin REF_MEASUREMENT myCar.EvasiveManeuver.SM_laneChange_left_instance.active myCar.EvasiveManeuver.SM_laneChange_left_instance.count myCar.EvasiveManeuver.SM_laneChange_left_instance.emergency_msg myCar.EvasiveManeuver.SM_laneChange_left_instance.max_count myCar.EvasiveManeuver.SM_laneChange_left_instance.sm myCar.EvasiveManeuver.SM_laneChange_left_instance.steering_out /end REF_MEASUREMENT
 /begin SUB_GROUP myCar.EvasiveManeuver.SM_laneChange_left_instance.obj_links myCar.EvasiveManeuver.SM_laneChange_left_instance.obj_rechts /end SUB_GROUP
/end GROUP
/begin GROUP myCar.EvasiveManeuver.SM_laneChange_left_instance.obj_links ""
 /begin REF_MEASUREMENT myCar.EvasiveManeuver.SM_laneChange_left_instance.obj_links.steering /end REF_MEASUREMENT
/end GROUP
/begin GROUP myCar.EvasiveManeuver.SM_laneChange_left_instance.obj_rechts ""
 /begin REF_MEASUREMENT myCar.EvasiveManeuver.SM_laneChange_left_instance.obj_rechts.steering /end REF_MEASUREMENT
/end GROUP
/begin GROUP myCar.EvasiveManeuver.SM_laneChange_right_instance ""
 /begin REF_MEASUREMENT myCar.EvasiveManeuver.SM_laneChange_right_instance.active myCar.EvasiveManeuver.SM_laneChange_right_instance.count myCar.EvasiveManeuver.SM_laneChange_right_instance.emergency_msg myCar.EvasiveManeuver.SM_laneChange_right_instance.max_count myCar.EvasiveManeuver.SM_laneChange_right_instance.sm myCar.EvasiveManeuver.SM_laneChange_right_instance.steering_out /end REF_MEASUREMENT
 /begin SUB_GROUP myCar.EvasiveManeuver.SM_laneChange_right_instance.obj_links myCar.EvasiveManeuver.SM_laneChange_right_instance.obj_rechts /end SUB_GROUP
/end GROUP
/begin GROUP myCar.EvasiveManeuver.SM_laneChange_right_instance.obj_links ""
 /begin REF_MEASUREMENT myCar.EvasiveManeuver.SM_laneChange_right_instance.obj_links.steering /end REF_MEASUREMENT
/end GROUP
/begin GROUP myCar.EvasiveManeuver.SM_laneChange_right_instance.obj_rechts ""
 /begin REF_MEASUREMENT myCar.EvasiveManeuver.SM_laneChange_right_instance.obj_rechts.steering /end REF_MEASUREMENT
/end GROUP
/begin GROUP myCar.TimeBase "" ROOT /end GROUP
/begin GROUP myCar.myCar "" ROOT /begin REF_CHARACTERISTIC myCar.myCar.g myCar.myCar.Landscape myCar.myCar.TrackSize /end REF_CHARACTERISTIC /begin REF_MEASUREMENT myCar.myCar.time /end REF_MEASUREMENT /begin SUB_GROUP myCar.myCar.myVehicle /end SUB_GROUP /end GROUP
/begin GROUP myCar.myCar.myVehicle ""
 /begin REF_CHARACTERISTIC myCar.myCar.myVehicle.BrakeMomentum myCar.myCar.myVehicle.EngineMomentum myCar.myCar.myVehicle.AirFriction /end REF_CHARACTERISTIC
 /begin REF_MEASUREMENT myCar.myCar.myVehicle.bearing myCar.myCar.myVehicle.dh myCar.myCar.myVehicle.dist myCar.myCar.myVehicle.ds myCar.myCar.myVehicle.h myCar.myCar.myVehicle.momentum myCar.myCar.myVehicle.v myCar.myCar.myVehicle.x myCar.myCar.myVehicle.y /end REF_MEASUREMENT
 /begin SUB_GROUP myCar.myCar.myVehicle.MyTurn_instance /end SUB_GROUP
/end GROUP
/begin GROUP myCar.myCar.myVehicle.MyTurn_instance "" /begin REF_CHARACTERISTIC myCar.myCar.myVehicle.MyTurn_instance.D /end REF_CHARACTERISTIC
 /begin REF_MEASUREMENT myCar.myCar.myVehicle.MyTurn_instance.bearing myCar.myCar.myVehicle.MyTurn_instance.dpi myCar.myCar.myVehicle.MyTurn_instance.pi myCar.myCar.myVehicle.MyTurn_instance.x myCar.myCar.myVehicle.MyTurn_instance.y /end REF_MEASUREMENT
 /begin SUB_GROUP myCar.myCar.myVehicle.MyTurn_instance.Lib /end SUB_GROUP
/end GROUP
/begin GROUP myCar.myCar.myVehicle.MyTurn_instance.Lib "MathLib is a C code class that returns the results of numerous mathematical functions." /end GROUP
/begin GROUP myCar.systemTest "" ROOT /begin REF_MEASUREMENT myCar.systemTest.systemTest_sucess /end REF_MEASUREMENT /end GROUP
/begin GROUP resources.CarMessages "" ROOT
 /begin REF_MEASUREMENT resources.CarMessages.SM_left_active resources.CarMessages.SM_right_active resources.CarMessages.bearing resources.CarMessages.brake resources.CarMessages.power resources.CarMessages.steering resources.CarMessages.v resources.CarMessages.x resources.CarMessages.y /end REF_MEASUREMENT
/end GROUP
/begin GROUP resources.DriverMessages "" ROOT
 /begin REF_MEASUREMENT resources.DriverMessages.automatic_laneChange_left resources.DriverMessages.automatic_laneChange_right resources.DriverMessages.brake resources.DriverMessages.deviation resources.DriverMessages.emergency resources.DriverMessages.laneChange_left resources.DriverMessages.laneChange_right resources.DriverMessages.on resources.DriverMessages.power resources.DriverMessages.real_distance_to_next_obst resources.DriverMessages.v_target /end REF_MEASUREMENT
/end GROUP
/end MODULE
/end PROJECT
